## package/triductor/ambiorix/apps/amxrt/Config.in
```kconfig
config PACKAGE_amxrt
    tristate
    select SAH_SERVICES_AMXRT

if PACKAGE_amxrt

menu "Select amxrt build options"
    depends on PACKAGE_amxrt

config SAH_SERVICES_AMXRT
    bool "Build libamxrt application"
    default y

config SAH_AMXRT_RWDATAPATH
    string "Persistent storage location"
    default "/etc/config"

endmenu

endif
```

## package/triductor/ambiorix/libs/libsahtrace/Config.in
```kconfig
config PACKAGE_libsahtrace
    tristate
    select SAH_LIB_SAHTRACE

if PACKAGE_libsahtrace

menu "Select libsahtrace build options"
    depends on PACKAGE_libsahtrace

config SAH_LIB_SAHTRACE
    bool "Build SAH trace library"
    default y

config SAH_TRACES_ENABLED
    bool "Enable SAH Traces"
    default y

config SAH_TRACES_LEVEL
    int "Maximum Trace Level"
    default 500

config SAH_TRACES_SYSLOG_CONSOLE
    bool "Fall back to console if syslog daemon is not running"
    default y

choice
    prompt "Trace Color Scheme"
    default SAH_TRACE_NO_COLORS

config SAH_TRACE_NO_COLORS
    bool "No colors"

config SAH_TRACE_COLORS
    bool "Full Color Scheme"

config SAH_TRACE_COLORS_SIMPLE
    bool "Simple Color Scheme"

endchoice

endmenu

endif
```

## target/linux/tr6560/files-5.10/arch/arm/mach-triductor/Kconfig
```kconfig
# SPDX-License-Identifier: GPL-2.0-only
menuconfig ARCH_TRIDUCTOR
	bool "Triductor SoC Support"
	depends on ARCH_MULTI_V7
	select ARM_GIC
	help
	  Support for Triductor All SoCs

if ARCH_TRIDUCTOR

choice
	prompt "MACH TRI SOC TYPE"
	depends on ARCH_TRIDUCTOR

config MACH_TR6560
	bool "Triductor TR6550 support"
	select ARM_TIMER_SP804
	select HAVE_ARM_TWD if SMP
	select PHYLINK

endchoice

menu "Triductor SOC options"
	depends on ARCH_TRIDUCTOR

config TRI_LSW
	bool "TRI LSW support"

endmenu
	   
endif
```
